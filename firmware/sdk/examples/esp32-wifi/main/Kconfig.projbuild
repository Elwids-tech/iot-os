## firmware/sdk/examples/esp32-wifi/main/Kconfig.projbuild
```kconfig
# SPDX-License-Identifier: MIT

menu "IoT OS application"

    config IOTOS_WIFI_SSID
        string "Wi-Fi network (SSID)"
        default ""
        help
            The 2.4 GHz network the device joins. idf.py keeps it in sdkconfig, which
            .gitignore keeps out of version control.

    config IOTOS_WIFI_PASSWORD
        string "Wi-Fi password"
        default ""
        help
            Empty for an open network. Kept in sdkconfig, like the network's name.

    config IOTOS_SNTP_SERVER
        string "SNTP server"
        default "pool.ntp.org"
        help
            Where the clock comes from. Readings wait until this server has answered,
            so the platform never receives readings stamped in the past.

endmenu
```

## firmware/waveshare-audio/sdkconfig.defaults
```kconfig
CONFIG_IDF_TARGET="esp32s3"
CONFIG_ESPTOOLPY_FLASHSIZE_16MB=y
CONFIG_ESP_CONSOLE_USB_SERIAL_JTAG=y
CONFIG_ESP_CONSOLE_SECONDARY_NONE=y
CONFIG_LOG_DEFAULT_LEVEL_ERROR=y
CONFIG_FREERTOS_HZ=1000
CONFIG_CODEC_I2C_BACKWARD_COMPATIBLE=n
CONFIG_ESP_MAIN_TASK_STACK_SIZE=8192
CONFIG_LOG_MAXIMUM_LEVEL_INFO=y
CONFIG_LOG_MAXIMUM_EQUALS_DEFAULT=n
CONFIG_MBEDTLS_CERTIFICATE_BUNDLE=y
CONFIG_PARTITION_TABLE_CUSTOM=y
CONFIG_PARTITION_TABLE_CUSTOM_FILENAME="partitions.csv"
```
